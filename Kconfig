## Kconfig
```kconfig
menu "ESP OpenTelemetry"

    config ESP_OPENTELEMETRY_HEAP_ALIGN_WORKAROUND
        bool "Override operator new to enforce alignof(max_align_t) alignment"
        default y
        help
            ESP-IDF's heap allocator uses sizeof(void*)=4 as its alignment
            granularity, violating the C/C++ requirement that malloc and
            operator new return memory aligned to alignof(max_align_t)=8.
            This override replaces the global operator new with one backed by
            heap_caps_aligned_alloc to guarantee 8-byte alignment.
            Disable only to reproduce the underlying heap alignment bug.

endmenu
```

## examples/basic/sdkconfig.defaults
```kconfig
CONFIG_IDF_TARGET="esp32s3"

CONFIG_FREERTOS_HZ=1000

CONFIG_SPIRAM=y
CONFIG_SPIRAM_SPEED_80M=y
CONFIG_SPIRAM_MODE_OCT=y

# OpenTelemetry tracing + its protobuf/Abseil dependencies blow past the
# stock "single app large" 1.5 MB factory partition. Grow flash to 4 MB
# and switch to a custom layout with a ~3.25 MB factory slot.
CONFIG_ESPTOOLPY_FLASHSIZE_4MB=y
CONFIG_PARTITION_TABLE_CUSTOM=y
CONFIG_PARTITION_TABLE_CUSTOM_FILENAME="partitions.csv"

CONFIG_ESP_OPENTELEMETRY_TRACING_ENABLED=y
CONFIG_ESP_OPENTELEMETRY_EXPORTER_OTLP_ENDPOINT=""
```

## examples/metrics/ostream/sdkconfig.defaults
```kconfig
CONFIG_IDF_TARGET="esp32s3"

CONFIG_FREERTOS_HZ=1000

CONFIG_PARTITION_TABLE_SINGLE_APP_LARGE=y

CONFIG_ESP_MAIN_TASK_STACK_SIZE=8192

CONFIG_ESP_OPENTELEMETRY_METRICS_ENABLED=y
CONFIG_ESP_OPENTELEMETRY_SERVICE_NAME="metrics-ostream-example"

# The metrics export thread (protobuf serialisation + periodic reader) needs
# more stack than the 3 KB IDF default.
CONFIG_PTHREAD_TASK_STACK_SIZE_DEFAULT=32768
```

## examples/metrics/otlp/sdkconfig.defaults
```kconfig
CONFIG_IDF_TARGET="esp32s3"

CONFIG_FREERTOS_HZ=1000

CONFIG_SPIRAM=y
CONFIG_SPIRAM_SPEED_80M=y
CONFIG_SPIRAM_MODE_OCT=y

# The OTLP/HTTP exporter pulls in protobuf + Abseil + opentelemetry-cpp,
# pushing the binary past the stock 1.5 MB factory partition. Grow flash to
# 4 MB and switch to a custom layout with a ~3.25 MB factory slot.
CONFIG_ESPTOOLPY_FLASHSIZE_4MB=y
CONFIG_PARTITION_TABLE_CUSTOM=y
CONFIG_PARTITION_TABLE_CUSTOM_FILENAME="partitions.csv"

CONFIG_ESP_MAIN_TASK_STACK_SIZE=8192

CONFIG_PTHREAD_TASK_STACK_SIZE_DEFAULT=32768

# Metrics only — tracing stays off to show the metrics signal standing alone.
CONFIG_ESP_OPENTELEMETRY_METRICS_ENABLED=y
CONFIG_ESP_OPENTELEMETRY_METRICS_OTLP_BASE_URL=""
CONFIG_ESP_OPENTELEMETRY_SERVICE_NAME="metrics-otlp-example"

CONFIG_WIFI_SSID=""
CONFIG_WIFI_PASSWORD=""
```

## examples/profiling/otlp/sdkconfig.defaults
```kconfig
CONFIG_IDF_TARGET="esp32s3"

CONFIG_FREERTOS_HZ=1000

CONFIG_SPIRAM=y
CONFIG_SPIRAM_SPEED_80M=y
CONFIG_SPIRAM_MODE_OCT=y

# OpenTelemetry tracing + its protobuf/Abseil dependencies blow past the
# stock "single app large" 1.5 MB factory partition. Grow flash to 4 MB
# and switch to a custom layout with a ~3.25 MB factory slot.
CONFIG_ESPTOOLPY_FLASHSIZE_4MB=y
CONFIG_PARTITION_TABLE_CUSTOM=y
CONFIG_PARTITION_TABLE_CUSTOM_FILENAME="partitions.csv"

CONFIG_ESP_MAIN_TASK_STACK_SIZE=8192

CONFIG_PTHREAD_TASK_STACK_SIZE_DEFAULT=32768

# Tracing gives the spans that span profiles link to; profiling samples the
# CPU. The per-task span slot needs a second FreeRTOS TLS pointer.
CONFIG_ESP_OPENTELEMETRY_TRACING_ENABLED=y
CONFIG_ESP_OPENTELEMETRY_TRACING_OTLP_BASE_URL=""
CONFIG_ESP_OPENTELEMETRY_PROFILING_ENABLED=y
CONFIG_ESP_OPENTELEMETRY_PROFILES_OTLP_BASE_URL=""
CONFIG_ESP_OPENTELEMETRY_PROFILING_EXPORT_INTERVAL_MS=2000
CONFIG_ESP_OPENTELEMETRY_SERVICE_NAME="profiling-otlp-example"
CONFIG_FREERTOS_THREAD_LOCAL_STORAGE_POINTERS=2

CONFIG_WIFI_SSID=""
CONFIG_WIFI_PASSWORD=""
```

## examples/profiling/serial/sdkconfig.defaults
```kconfig
CONFIG_IDF_TARGET="esp32s3"

CONFIG_FREERTOS_HZ=1000

CONFIG_PARTITION_TABLE_SINGLE_APP_LARGE=y

CONFIG_ESP_MAIN_TASK_STACK_SIZE=8192

# Profiling only — no tracing SDK, no Wi-Fi. Profiles are dumped to the serial
# console as OTLP/JSON (PROFILE_JSON_BEGIN/END markers) so the whole sampler ->
# span slot -> exporter path is observable (and CI-testable in QEMU) without
# any backend. The per-task span slot needs a second FreeRTOS TLS pointer.
CONFIG_ESP_OPENTELEMETRY_PROFILING_ENABLED=y
CONFIG_ESP_OPENTELEMETRY_PROFILING_EXPORT_INTERVAL_MS=1000
CONFIG_ESP_OPENTELEMETRY_PROFILES_DEBUG_JSON=y
CONFIG_ESP_OPENTELEMETRY_SERVICE_NAME="profiling-serial-example"
CONFIG_FREERTOS_THREAD_LOCAL_STORAGE_POINTERS=2
```

## examples/propagation/main/Kconfig.projbuild
```kconfig
menu "Propagation Example Configuration"

    config WIFI_SSID
        string "Wi-Fi SSID"
        default ""
        help
            SSID of the Wi-Fi network to connect to.

    config WIFI_PASSWORD
        string "Wi-Fi password"
        default ""
        help
            Password of the Wi-Fi network.

    config TARGET_URL
        string "Target HTTP URL"
        default "http://192.168.1.10:8080/"
        help
            URL the example POSTs to. The server should log the
            traceparent header so you can verify propagation.

endmenu
```

## examples/propagation/sdkconfig.defaults
```kconfig
CONFIG_IDF_TARGET="esp32s3"

CONFIG_FREERTOS_HZ=1000

CONFIG_SPIRAM=y
CONFIG_SPIRAM_SPEED_80M=y
CONFIG_SPIRAM_MODE_OCT=y

# OpenTelemetry tracing + its protobuf/Abseil dependencies blow past the
# stock "single app large" 1.5 MB factory partition. Grow flash to 4 MB
# and switch to a custom layout with a ~3.25 MB factory slot.
CONFIG_ESPTOOLPY_FLASHSIZE_4MB=y
CONFIG_PARTITION_TABLE_CUSTOM=y
CONFIG_PARTITION_TABLE_CUSTOM_FILENAME="partitions.csv"

CONFIG_ESP_MAIN_TASK_STACK_SIZE=8192

CONFIG_ESP_OPENTELEMETRY_TRACING_ENABLED=y
CONFIG_ESP_OPENTELEMETRY_EXPORTER_OTLP_ENDPOINT=""
CONFIG_ESP_OPENTELEMETRY_SERVICE_NAME="propagation-example"

CONFIG_PTHREAD_TASK_STACK_SIZE_DEFAULT=32768

CONFIG_WIFI_SSID=""
CONFIG_WIFI_PASSWORD=""
CONFIG_TARGET_URL=""
```

## examples/tracing/batch/main/Kconfig.projbuild
```kconfig
menu "Batch Example Configuration"

    config WIFI_SSID
        string "Wi-Fi SSID"
        default ""
        help
            SSID of the Wi-Fi network to connect to.

    config WIFI_PASSWORD
        string "Wi-Fi password"
        default ""
        help
            Password of the Wi-Fi network.

endmenu
```

## test/heap_align_idf/sdkconfig.defaults
```kconfig
CONFIG_IDF_TARGET="esp32s3"

CONFIG_FREERTOS_HZ=1000

CONFIG_PARTITION_TABLE_SINGLE_APP_LARGE=y

CONFIG_ESP_MAIN_TASK_STACK_SIZE=8192
```

## test/heap_align_protobuf/sdkconfig.defaults
```kconfig
CONFIG_IDF_TARGET="esp32s3"

CONFIG_FREERTOS_HZ=1000

# OpenTelemetry tracing + protobuf/Abseil push the binary past 3 MB.
# Use a 4 MB flash with a custom layout giving ~3.25 MB for the app.
CONFIG_ESPTOOLPY_FLASHSIZE_4MB=y
CONFIG_PARTITION_TABLE_CUSTOM=y
CONFIG_PARTITION_TABLE_CUSTOM_FILENAME="partitions.csv"

CONFIG_ESP_MAIN_TASK_STACK_SIZE=8192

CONFIG_ESP_OPENTELEMETRY_TRACING_ENABLED=y

# The BatchSpanProcessor background thread needs more than the 3 KB default.
CONFIG_PTHREAD_TASK_STACK_SIZE_DEFAULT=32768
```
