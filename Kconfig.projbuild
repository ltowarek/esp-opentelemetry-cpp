## Kconfig.projbuild
```kconfig
menu "OpenTelemetry"
    config ESP_OPENTELEMETRY_SERVICE_NAME
        string "Service name resource attribute"
        default "esp-opentelemetry-cpp"

    config ESP_OPENTELEMETRY_SERVICE_REPOSITORY
        string "Service repository resource attribute (GitHub URL)"
        default ""
        help
            GitHub repository URL, e.g. "https://github.com/org/repo".
            Stamped as service_repository (profiles) and
            vcs.repository.url.full (traces/metrics). Empty omits both.

    config ESP_OPENTELEMETRY_SERVICE_ROOT_PATH
        string "Service root path resource attribute"
        default ""
        help
            Path within the repository where this service's code lives.
            Stamped as service_root_path on profiles only. Empty omits the
            attribute.

    menu "Exporters to compile in"
        comment "Which exporter implementations are available to the application."

    config ESP_OPENTELEMETRY_EXPORTER_OTLP_HTTP
        bool "OTLP/HTTP exporters"
        default y
        help
            Compiles esp_opentelemetry::MakeOtlpHttp*Exporter(), which POST
            OTLP/JSON to a collector through esp_http_client. Pulls in the
            SDK's OTLP/HTTP exporter family.

    choice ESP_OPENTELEMETRY_OTLP_HTTP_ENCODING
        prompt "OTLP/HTTP serialization"
        depends on ESP_OPENTELEMETRY_EXPORTER_OTLP_HTTP
        default ESP_OPENTELEMETRY_OTLP_HTTP_ENCODING_JSON
        help
            Which serializer the OTLP/HTTP exporters use. Both put the same
            OTLP/JSON on the wire; they differ in what the firmware links to
            produce it.

    config ESP_OPENTELEMETRY_OTLP_HTTP_ENCODING_JSON
        bool "OTLP/JSON (no protobuf)"
        help
            The SDK's OtlpJsonHttp* exporters, which map SDK recordables
            straight to JSON tokens emitted through this component's cJSON
            writer. Neither protobuf nor Abseil is compiled or linked.

    config ESP_OPENTELEMETRY_OTLP_HTTP_ENCODING_PROTOBUF
        bool "OTLP/JSON via protobuf"
        help
            The SDK's OtlpHttp* exporters, which serialize through
            protobuf-generated OTLP messages and their JSON reflection.
            Compiles libprotobuf and Abseil into the image; kept so the two
            paths can be compared on the same hardware.

    endchoice

    config ESP_OPENTELEMETRY_EXPORTER_OSTREAM
        bool "Console (ostream) exporters"
        default n
        help
            Compiles the SDK's ostream exporters, which print each signal to
            stdout. Useful for bring-up and QEMU runs; the output is
            human-readable rather than OTLP, so nothing forwards it.

    config ESP_OPENTELEMETRY_EXPORTER_JTAG
        bool "JTAG app-trace exporters"
        depends on ESP_TRACE_TRANSPORT_APPTRACE
        depends on APPTRACE_DEST_JTAG || APPTRACE_DEST_ALL
        default n
        help
            Compiles esp_opentelemetry::Jtag*Exporter, which write OTLP/JSON -
            one document per line, the same encoding the OTLP/HTTP exporters
            send - to the ESP-IDF app-trace channel, with no network involved.
            A host-side reader (OpenOCD's "esp apptrace start" feeding Vector
            or Fluent Bit) forwards the lines to a collector. Every signal
            shares the one channel, one whole document at a time.

            Requires the app-trace transport with a destination that compiles
            the JTAG interface, both under "ESP Trace Configuration";
            APPTRACE_DEST_JTAG in turn requires power management to be off.
            See examples/jtag.

    config ESP_OPENTELEMETRY_JTAG_TIMEOUT_US
        int "app-trace write timeout (us)"
        depends on ESP_OPENTELEMETRY_EXPORTER_JTAG
        default 100000
        range 0 10000000
        help
            How long a single app-trace write may block the exporting task
            waiting for a connected host to drain the pending block; the
            document is dropped once it expires. With no host connected
            app-trace recycles buffers without waiting, so writes return
            immediately and this value does not apply. It also caps
            ForceFlush/Shutdown, whose SDK default of "no timeout" would
            otherwise wait forever. 0 never blocks, at the cost of dropping
            documents whenever a buffer swap is in flight.

    config ESP_OPENTELEMETRY_JTAG_CHUNK_SIZE
        int "app-trace write chunk size (bytes)"
        depends on ESP_OPENTELEMETRY_EXPORTER_JTAG
        default 256
        range 64 4096
        help
            An OTLP/JSON document is larger than the app-trace buffer, so it is
            written in chunks of this size. Larger chunks cost fewer calls;
            smaller ones fit more easily into the space left in a partially
            filled buffer.

    endmenu

    config ESP_OPENTELEMETRY_TRACING_ENABLED
        bool "Enable OpenTelemetry tracing"
        default n

    config ESP_OPENTELEMETRY_TRACING_OTLP_BASE_URL
        string "Tracing OTLP base URL (e.g. http://192.168.1.10:4318)"
        depends on ESP_OPENTELEMETRY_TRACING_ENABLED && ESP_OPENTELEMETRY_EXPORTER_OTLP_HTTP
        default ""
        help
            Base URL for OTLP/HTTP trace export. The path "/v1/traces" is
            appended automatically. Must be reachable from the device over
            Wi-Fi (a plain host:port URL - the ESP32 has no mDNS/service
            discovery).

    config ESP_OPENTELEMETRY_PROFILING_ENABLED
        bool "Enable statistical CPU profiler"
        default n
        help
            Enables a per-core timer-ISR sampling profiler that captures the
            interrupted call stack via esp_backtrace, aggregates identical
            stacks into counts (pprof semantics), and exports them as
            OpenTelemetry profiles. Intended for on-target debugging of where
            CPU time goes; leave disabled in production. Adds a small
            per-sample overhead and two timer interrupts.

    config ESP_OPENTELEMETRY_PROFILING_SAMPLE_HZ
        int "Sample rate per core (Hz)"
        depends on ESP_OPENTELEMETRY_PROFILING_ENABLED
        default 100
        range 1 1000
        help
            Per-core sampling frequency. Keep at or below ~200 Hz/core:
            Xtensa stack unwinding is not free, and higher rates perturb the
            real-time workload being measured.

    config ESP_OPENTELEMETRY_PROFILING_MAX_DEPTH
        int "Maximum stack depth per sample"
        depends on ESP_OPENTELEMETRY_PROFILING_ENABLED
        default 16
        range 4 64
        help
            Number of call frames captured per sample. Deeper stacks cost more
            ISR time and RAM (each ring slot is sized for this depth).

    config ESP_OPENTELEMETRY_PROFILING_RING_CAPACITY
        int "Per-core sample ring capacity"
        depends on ESP_OPENTELEMETRY_PROFILING_ENABLED
        default 128
        range 16 1024
        help
            Number of raw samples buffered per core between export-task drains.
            A full ring drops new samples. Internal RAM use per core is roughly
            capacity * (32 + 4 * max-depth) bytes.

    config ESP_OPENTELEMETRY_PROFILING_EXPORT_INTERVAL_MS
        int "Profiles export interval (ms)"
        depends on ESP_OPENTELEMETRY_PROFILING_ENABLED
        default 5000
        help
            How often the aggregation/export task folds identical stacks into
            counts and exports a profile. (The rings are drained far more often
            so they cannot overflow.)

    config ESP_OPENTELEMETRY_PROFILING_MAX_UNIQUE_STACKS
        int "Max unique stacks per export window"
        depends on ESP_OPENTELEMETRY_PROFILING_ENABLED
        default 256
        range 16 4096
        help
            Bound on distinct (task, span, stack) combinations aggregated per
            export window; further unique stacks in the window are dropped.
            The aggregation tables cost roughly 128 bytes per entry, allocated
            from PSRAM when available.

    config ESP_OPENTELEMETRY_PROFILING_DEBUG_LOG
        bool "Log aggregated stacks each export window"
        depends on ESP_OPENTELEMETRY_PROFILING_ENABLED
        default n
        help
            Logs every aggregated stack (raw PCs) at each export. Useful for
            validating the sampler on hardware with xtensa-esp-elf-addr2line;
            noisy, so leave disabled in normal use.

    config ESP_OPENTELEMETRY_PROFILES_OTLP_BASE_URL
        string "Profiles OTLP/HTTP endpoint (the profiling-symbolizer)"
        depends on ESP_OPENTELEMETRY_PROFILING_ENABLED && ESP_OPENTELEMETRY_EXPORTER_OTLP_HTTP
        default ""
        help
            Base URL of the profiling-symbolizer; "/v1development/profiles" is
            appended automatically. esp_opentelemetry::export_profiles() POSTs
            unsymbolized OTLP/JSON profiles here and the symbolizer resolves
            them against the firmware ELF before forwarding to the collector.
            Distinct from the tracing endpoint (profiles go via the symbolizer,
            not directly to the collector). Leave empty to disable export.

    config ESP_OPENTELEMETRY_PROFILES_SPAN_ATTRIBUTE
        string "Span attribute linking spans to profiles"
        depends on ESP_OPENTELEMETRY_PROFILING_ENABLED
        default "pyroscope.profile.id"
        help
            Attribute key stamped (with the span id as hex value) on every
            activated span so a trace backend can link the span to its profile
            samples. The default follows the Grafana span-profiles convention
            (Tempo's "Profiles for this span" flame graph); other backends may
            use a different key. Set empty to disable stamping.

    config ESP_OPENTELEMETRY_BATCH_MAX_QUEUE_SIZE
        int "Max queued spans before drop"
        depends on ESP_OPENTELEMETRY_TRACING_ENABLED
        default 64

    config ESP_OPENTELEMETRY_BATCH_SCHEDULE_DELAY_MS
        int "Batch span processor schedule delay (ms)"
        depends on ESP_OPENTELEMETRY_TRACING_ENABLED
        default 5000

    config ESP_OPENTELEMETRY_LOGS_ENABLED
        bool "Enable OpenTelemetry logs"
        default n
        help
            Compiles the logs SDK and enables
            esp_opentelemetry_logs_setup(), which installs a
            BatchLogRecordProcessor exporting via OTLP/HTTP. Include
            esp_log_otel.h in a translation unit to route its existing
            ESP_LOGI/W/E call sites through the logger as well.

    config ESP_OPENTELEMETRY_LOGS_OTLP_BASE_URL
        string "Logs OTLP base URL"
        depends on ESP_OPENTELEMETRY_LOGS_ENABLED && ESP_OPENTELEMETRY_EXPORTER_OTLP_HTTP
        default ""
        help
            Base URL for OTLP/HTTP log export. The path "/v1/logs" is
            appended automatically. Required when logs are enabled; when
            empty, log export stays disabled.

    config ESP_OPENTELEMETRY_LOGS_BATCH_MAX_QUEUE_SIZE
        int "Max queued log records before drop"
        depends on ESP_OPENTELEMETRY_LOGS_ENABLED
        default 128
        help
            Records emitted once the queue is full are dropped rather than
            blocking the logging call site.

    config ESP_OPENTELEMETRY_LOGS_BATCH_SCHEDULE_DELAY_MS
        int "Batch log record processor schedule delay (ms)"
        depends on ESP_OPENTELEMETRY_LOGS_ENABLED
        default 5000

    config ESP_OPENTELEMETRY_LOGS_MAX_BODY_LEN
        int "Maximum formatted log body length (bytes)"
        depends on ESP_OPENTELEMETRY_LOGS_ENABLED
        default 256
        range 64 1024
        help
            The ESP_LOG wrapper formats each message once into a buffer of
            this size and feeds both the console and the exporter from it, so
            a log call never allocates from the heap and its arguments are
            evaluated exactly once. A longer message is truncated in the
            console line as well as in the record.

    config ESP_OPENTELEMETRY_METRICS_ENABLED
        bool "Enable OpenTelemetry metrics"
        default n
        help
            Compiles the metrics SDK and enables
            esp_opentelemetry_metrics_setup(), which installs a
            PeriodicExportingMetricReader exporting via OTLP/HTTP.

    config ESP_OPENTELEMETRY_METRICS_EXPORT_INTERVAL_MS
        int "Metrics export interval (ms)"
        depends on ESP_OPENTELEMETRY_METRICS_ENABLED
        default 500
        help
            How often the PeriodicExportingMetricReader collects and exports
            metrics.

    config ESP_OPENTELEMETRY_METRICS_OTLP_BASE_URL
        string "Metrics OTLP base URL"
        depends on ESP_OPENTELEMETRY_METRICS_ENABLED && ESP_OPENTELEMETRY_EXPORTER_OTLP_HTTP
        default ""
        help
            Base URL for OTLP/HTTP metrics export. The path "/v1/metrics" is
            appended automatically. Required when metrics are enabled; when
            empty, metrics export stays disabled.
endmenu
```

## test/heap_align_cjson/main/Kconfig.projbuild
```kconfig
menu "heap_align_cjson"
    config HEAP_ALIGN_CJSON_UBSAN
        bool "Build cJSON and main with -fsanitize=undefined"
        default n
endmenu
```

## test/signals_disabled/sdkconfig.defaults
```kconfig
CONFIG_IDF_TARGET="esp32s3"

CONFIG_FREERTOS_HZ=1000

CONFIG_SPIRAM=y
CONFIG_SPIRAM_SPEED_80M=y
CONFIG_SPIRAM_MODE_OCT=y

CONFIG_PARTITION_TABLE_SINGLE_APP_LARGE=y

# Every exporter family compiled in, every signal off.
CONFIG_ESP_TRACE_TRANSPORT_APPTRACE=y
CONFIG_APPTRACE_DEST_JTAG=y
CONFIG_ESP_OPENTELEMETRY_EXPORTER_OTLP_HTTP=y
CONFIG_ESP_OPENTELEMETRY_EXPORTER_JTAG=y
CONFIG_ESP_OPENTELEMETRY_EXPORTER_ESP_LOG=y
CONFIG_ESP_OPENTELEMETRY_TRACING_ENABLED=n
CONFIG_ESP_OPENTELEMETRY_METRICS_ENABLED=n
CONFIG_ESP_OPENTELEMETRY_LOGS_ENABLED=n
CONFIG_ESP_OPENTELEMETRY_PROFILING_ENABLED=n
```
